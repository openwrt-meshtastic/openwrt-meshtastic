/dts-v1/;
/plugin/;

/ {
    compatible = "mediatek,mt7981b";

    fragment@0 {
        target-path = "/spi1";
        __overlay__ {
            spidev@0 {
                compatible = "linux,spidev";
                reg = <0>;
                #address-cells = <1>;
                #size-cells = <0>;
                spi-max-frequency = <52000000>;
                status = "okay";
            };
        };
    };
};
